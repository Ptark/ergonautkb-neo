## boards/shields/ergonautkb_neo/Kconfig.defconfig
```kconfig
if SHIELD_ERGONAUTKB_NEO_LEFT

config ZMK_KEYBOARD_NAME
    default "ergonautkb_neo"

config ZMK_SPLIT_ROLE_CENTRAL
    default y

endif # SHIELD_ERGONAUTKB_NEO_LEFT

if SHIELD_ERGONAUTKB_NEO_LEFT || SHIELD_ERGONAUTKB_NEO_RIGHT

config ZMK_SPLIT
    default y

config SETTINGS_NVS
    default y

endif # SHIELD_ERGONAUTKB_NEO_LEFT || SHIELD_ERGONAUTKB_NEO_RIGHT
```

## boards/shields/ergonautkb_neo/Kconfig.shield
```kconfig
config SHIELD_ERGONAUTKB_NEO_LEFT
    def_bool $(shields_list_contains,ergonautkb_neo_left)

config SHIELD_ERGONAUTKB_NEO_RIGHT
    def_bool $(shields_list_contains,ergonautkb_neo_right)
```
